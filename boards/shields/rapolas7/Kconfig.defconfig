## boards/shields/rapolas7/Kconfig.defconfig
```kconfig
if SHIELD_RAPOLAS7_LEFT

# Name must be less than 16 characters long!
config ZMK_KEYBOARD_NAME
    default "rapolas7"

config ZMK_SPLIT_ROLE_CENTRAL
    default y

endif

if SHIELD_RAPOLAS7_LEFT || SHIELD_RAPOLAS7_RIGHT

config ZMK_SPLIT
    default y

endif
```

## boards/shields/rapolas7/Kconfig.shield
```kconfig
config SHIELD_RAPOLAS7_LEFT
    def_bool $(shields_list_contains,rapolas7_left)

config SHIELD_RAPOLAS7_RIGHT
    def_bool $(shields_list_contains,rapolas7_right)
```
